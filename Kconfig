## Kconfig
```kconfig
choice SELECT_CODE_GEN_FORMAT
    prompt "Select the format of the generated code"
    default SELECT_CODE_GEN_FORMAT_DUMMY

config SELECT_CODE_GEN_FORMAT_DUMMY
    bool "Gen only loginfo to file"
config SELECT_CODE_GEN_FORMAT_LLVM
    bool "Gen LLVM IR"
# config SELECT_CODE_GEN_FORMAT_X86_ASM
#     bool "Gen x86 asm"
endchoice

choice SELECT_PARSER
    prompt "Select the parser to use"
    default SELECT_PARSER_TOP_DOWN

config SELECT_PARSER_TOP_DOWN
    bool "Use top down parser."
config SELECT_PARSER_LL1_SHEET
    bool "Use LL1 sheet parser."
config SELECT_PARSER_LR1
    bool "Use LR1 parser."
endchoice

choice SELECT_REDUCE_FN
depends on SELECT_PARSER_LR1
    prompt "Select the reduce function to use"
    default SELECT_REDUCE_FN_PREWRITE
config SELECT_REDUCE_FN_PREWRITE
    bool "Use prewrite reduce function."
config SELECT_REDUCE_FN_SELFWRITE
    bool "Use self write reduce function."
endchoice

config REDUCE_FN_PATH
depends on SELECT_REDUCE_FN_SELFWRITE
    string "Reduce function path."
    default "src/reduce_fn"

config OPEN_DEBUG
    bool "Open debug config for compile"
    default y
```
